// USB2 ports support for OnLogic FR201
/dts-v1/;
/plugin/;

/ {
	compatible = "brcm,bcm2711";
	fragment@0 {
		target = <&xhci>;
		__overlay__ {
			compatible = "generic-xhci\0brcm,generic-xhci";
			status = "okay";
		};
	};
};
